## config/west.yml
```yaml
manifest:
  remotes:
    - name: zmkfirmware
      url-base: https://github.com/zmkfirmware
    - name: englmaxi
      url-base: https://github.com/englmaxi
  projects:
    - name: zmk
      remote: zmkfirmware
      revision: v0.3
      import: app/west.yml
    - name: zmk-keyboards-totem
      url: https://github.com/victorlucachi/zmk-keyboards-totem
      revision: main
      path: modules/zmk-keyboards-totem
    - name: zmk-dongle-display
      remote: englmaxi
      # Use the stable v0.3.0 tag which is compatible with Zephyr 3.5 / LVGL 8
      revision: v0.3.0
  self:
    path: config
```
